/*@!Encoding:65001*/
// Generated by canoe/tools/risk_reference.py from safety_ecu (do not edit by hand)
variables
{
  const long REF_COUNT = 24;
  long refPresent[24] = {1, 1, 1, 1, 1, 1, 1, 1, 1, 1, 1, 1, 1, 1, 1, 1, 1, 1, 1, 1, 1, 1, 0, 1};
  float refDist[24] = {40.0000, 20.0000, 14.0000, 8.0000, 40.0000, 5.0000, 40.0000, 40.0000, 40.0000, 40.0000, 12.0000, 40.0000, 40.0000, 40.0000, 8.0000, 25.0000, 25.0100, 40.0000, 40.0000, 9.0000, 9.0000, 9.0000, 0.0000, 40.0000};
  float refSpeed[24] = {20.0000, 20.0000, 25.0000, 29.0000, 0.0000, 0.0000, 30.0000, 0.0000, 30.0000, 30.0000, 0.0000, 30.0000, 30.0000, 30.0000, 30.0000, 0.0000, 0.0000, 30.0000, 30.0000, 0.0000, 0.0000, 30.0000, 50.0000, 0.0000};
  float refClosing[24] = {5.5600, 5.5600, 6.9400, 8.0000, 0.0000, 0.0000, 40.0000, 0.0000, 20.0000, 33.3000, 0.0000, 20.0000, 20.0000, 20.0000, 8.0000, 0.0000, 0.0000, 16.0000, 15.9000, 0.0000, 0.0000, -2.0000, 0.0000, 0.0000};
  float refTtc[24] = {7.2000, 3.5000, 2.0000, 1.0000, -1.0000, -1.0000, 1.0000, -1.0000, 2.0000, 1.2000, -1.0000, 2.0000, 2.0000, 2.0000, 1.0000, -1.0000, -1.0000, 2.5000, 2.5100, -1.0000, -1.0000, -1.0000, -1.0000, -1.0000};
  long refAccel[24] = {30, 30, 30, 30, 0, 0, 0, 95, 80, 30, 30, 80, 80, 30, 30, 60, 60, 75, 75, 10, 10, 95, 95, 0};
  long refBrake[24] = {0, 0, 0, 0, 0, 0, 0, 0, 0, 0, 0, 10, 4, 30, 30, 0, 0, 0, 0, 0, 0, 0, 0, 0};
  float refRate[24] = {0.0, 0.0, 0.0, 0.0, 0.0, 0.0, 0.0, 0.0, 0.0, 700.0, 460.0, 0.0, 0.0, 0.0, 0.0, 0.0, 0.0, 0.0, 0.0, 649.9, 650.0, 0.0, 0.0, 0.0};
  float refBns[24] = {0.000000, 0.500000, 0.775000, 0.933333, 0.000000, 0.950000, 0.933333, 0.000000, 0.775000, 0.920000, 0.800000, 0.775000, 0.775000, 0.775000, 0.933333, 0.350000, 0.000000, 0.650000, 0.648000, 0.910000, 0.910000, 0.910000, 0.000000, 0.000000};
  float refPms[24] = {0.000000, 0.000000, 0.000000, 0.000000, 0.000000, 0.000000, 0.000000, 0.933333, 0.733333, 0.925000, 0.662500, 0.000000, 0.733333, 0.650000, 0.650000, 0.350000, 0.350000, 0.650000, 0.650000, 0.899875, 0.900000, 0.933333, 0.933333, 0.000000};
  float refTotal[24] = {0.000000, 0.500000, 0.775000, 0.933333, 0.000000, 0.950000, 0.933333, 0.933333, 0.775000, 0.925000, 0.800000, 0.775000, 0.775000, 0.775000, 0.933333, 0.350000, 0.350000, 0.650000, 0.650000, 0.910000, 0.910000, 0.933333, 0.933333, 0.000000};
  long refLevel[24] = {0, 1, 2, 3, 0, 0, 0, 0, 2, 3, 2, 0, 2, 2, 3, 1, 0, 2, 1, 2, 3, 3, 0, 0};
  long refVib[24] = {0, 1, 1, 1, 0, 0, 0, 0, 1, 1, 1, 0, 1, 1, 1, 1, 0, 1, 1, 1, 1, 1, 0, 0};
  long refIntensity[24] = {0, 30, 45, 65, 0, 0, 0, 0, 45, 65, 45, 0, 45, 45, 65, 30, 0, 45, 30, 45, 65, 65, 0, 0};
  long refFrequency[24] = {0, 20, 20, 30, 0, 0, 0, 0, 20, 30, 20, 0, 20, 20, 30, 20, 0, 20, 20, 20, 30, 30, 0, 0};
  long refMode[24] = {0, 0, 1, 2, 0, 0, 0, 0, 1, 2, 1, 0, 1, 1, 2, 0, 0, 1, 0, 1, 2, 2, 0, 0};
  long refLimit[24] = {100, 100, 30, 0, 100, 100, 100, 100, 30, 0, 30, 100, 30, 30, 0, 100, 100, 30, 100, 30, 0, 0, 100, 100};
  long refFlags[24] = {1, 1, 1, 1, 1, 1, 1, 1, 1, 1, 1, 1, 1, 1, 1, 1, 1, 1, 1, 1, 1, 1, 1, 1};
}
