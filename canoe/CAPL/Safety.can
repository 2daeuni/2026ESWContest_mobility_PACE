/*@!Encoding:65001*/
// ============================================================================
// Safety ECU (Raspberry Pi) simulation node
// Reference implementation: safety_ecu/ (main.py, risk/bns.py, risk/pms.py,
// risk/risk_manager.py, control/failsafe.py, control/command_mapper.py)
// Input mode: CARLA (the real Safety ECU runs INPUT_MODE = CARLA).
// In CANoe the CARLA link is replaced by a simulated environment
// (obstacle distance, vehicle speed, closing speed, TTC).
//
// Rx: PEDAL_STATUS (0x100), HAPTIC_STATUS (0x200), MOTOR_STATUS (0x210)
// Tx: HAPTIC_COMMAND (0x110), MOTOR_COMMAND (0x120), 10 ms
//
// Timing:
//   - Risk evaluation runs every RISK_EVAL_PERIOD_MS (the Python main loop
//     evaluates once per loop iteration, about 1 ms). The 3-up / 5-down
//     confirmation counts are evaluation counts, not CAN frame counts.
//   - Commands are transmitted every 10 ms with the latest evaluated state.
// ============================================================================

includes
{
}

variables
{
  // ---- Timing ----
  const long  CMD_TX_PERIOD_MS        = 10;
  const long  RISK_EVAL_PERIOD_MS     = 1;
  const float PEDAL_TIMEOUT_MS        = 100.0;   // main.py: >= 0.1 s -> pedal disconnected
  const float HAPTIC_TIMEOUT_MS       = 100.0;   // state.check_haptic_freshness(timeout=0.1)
  const float MOTOR_STATUS_FRESH_MS   = 100.0;   // main.py: 0 <= dt <= 0.1 s -> fresh

  // ---- BNS thresholds (risk/bns.py) ----
  const float BNS_DISTANCE_L1_M = 25.0;
  const float BNS_DISTANCE_L2_M = 15.0;
  const float BNS_DISTANCE_L3_M = 10.0;
  const float BNS_TTC_L1_S      = 4.0;
  const float BNS_TTC_L2_S      = 2.5;
  const float BNS_TTC_L3_S      = 1.5;

  // ---- PMS thresholds (risk/pms.py) ----
  const float PMS_ACCEL_L1_PERCENT = 60.0;
  const float PMS_ACCEL_L2_PERCENT = 75.0;
  const float PMS_ACCEL_L3_PERCENT = 90.0;
  const float PMS_ACCEL_RATE_L1    = 250.0;   // %/s
  const float PMS_ACCEL_RATE_L2    = 450.0;
  const float PMS_ACCEL_RATE_L3    = 650.0;
  const long  PMS_BRAKE_SUPPRESSION_PERCENT = 5;
  const long  PMS_CONFLICT_ACCEL_PERCENT    = 20;
  const long  PMS_CONFLICT_BRAKE_PERCENT    = 20;
  const float PMS_CONFLICT_SCORE            = 0.65;

  // ---- RiskManager (risk/risk_manager.py) ----
  const long UP_CONFIRM_COUNT_REQUIRED   = 3;
  const long DOWN_CONFIRM_COUNT_REQUIRED = 5;

  // ---- Motor E-STOP recovery (main.py) ----
  const long RECOVERY_ACCEL_MAX_PERCENT = 3;    // accelerator <= 3 %
  const long RECOVERY_BRAKE_MAX_PERCENT = 5;    // brake < 5 %

  // ---- Command mapping (control/command_mapper.py), index = risk level ----
  byte mapVibCmd[4]    = {0,   1,  1,  1};
  byte mapIntensity[4] = {0,  30, 45, 65};
  byte mapFrequency[4] = {0,  20, 20, 30};
  byte mapCtrlMode[4]  = {0,   0,  1,  2};    // Normal, Normal, Output Limit, Stop
  byte mapOutLimit[4]  = {100, 100, 30, 0};

  const int MODE_NORMAL = 0;
  const int MODE_LIMIT  = 1;
  const int MODE_STOP   = 2;
  const int FLAG_VALID  = 0x01;
  const int FLAG_ESTOP  = 0x02;

  // Fail-safe reason codes (Safety::FailSafeReason)
  const long FS_NONE         = 0;
  const long FS_CARLA_LINK   = 1;   // CARLA_COMMUNICATION_ERROR
  const long FS_PEDAL_COMM   = 2;   // PEDAL_COMMUNICATION_ERROR
  const long FS_PEDAL_SENSOR = 3;   // PEDAL_SENSOR_ERROR

  message HAPTIC_COMMAND mHapCmd;
  message MOTOR_COMMAND  mMotCmd;
  msTimer tEval;
  msTimer tTx;

  // ---- Pedal reception (main.py PEDAL_STATUS handling) ----
  int   pedalConnected;
  float lastPedalTime;
  long  prevAlive;              // -1 = None
  long  recoveryAliveCand;      // -1 = None
  int   pedalTimeoutReported;
  long  accel;
  long  brake;
  float accelRate;
  float brakeRate;
  long  sensorStatus;           // -1 = None (no frame accepted yet)

  // ---- Haptic status ----
  int   hapticConnected;
  float lastHapticTime;
  long  hapFault;
  long  hapCmdTimeout;
  long  hapEcuStatus;

  // ---- Motor status ----
  int   motStatusReceived;
  float motLastRxTime;
  long  motFaultFlags;
  long  motState;
  long  motPwm;
  int   motRecoveryRequired;

  // ---- Simulated environment (replaces CARLA UDP) ----
  float obsDist;                // obstacle distance [m]

  // ---- BNS / PMS / Risk ----
  float bnsScore;
  int   bnsAvailable;
  int   dL1, dL2, dL3;          // distance conditions
  int   tL1, tL2, tL3;          // TTC conditions
  float pmsScore;
  int   pmsAvailable;
  int   pL1, pL2, pL3;          // pedal conditions
  int   pedalConflict;
  float totalRisk;
  long  riskLevel;
  int   riskAvailable;
  long  candidateLevel;
  long  prevCandidateLevel;
  long  candidateCount;

  // ---- Fail-safe ----
  int   failsafeActive;
  long  failsafeReason;

  // ---- Environment values shown on the Panel ----
  float envTtc;                 // valid only when envTtcValid
  int   envTtcValid;

  // ---- Alive counters ----
  byte  hapCnt;
  byte  motCnt;
}

on start
{
  float t;
  t = nowMs();

  pedalConnected       = 0;
  lastPedalTime        = t;
  prevAlive            = -1;
  recoveryAliveCand    = -1;
  pedalTimeoutReported = 0;
  accel = 0;
  brake = 0;
  accelRate = 0;
  brakeRate = 0;
  sensorStatus = -1;

  hapticConnected = 0;
  lastHapticTime  = t;
  hapFault        = 0;
  hapCmdTimeout   = 1;
  hapEcuStatus    = 0;

  motStatusReceived   = 0;
  motLastRxTime       = t;
  motFaultFlags       = 0;
  motState            = 0;
  motPwm              = 0;
  motRecoveryRequired = 1;

  obsDist = @Safety::ObstacleInitDist;
  @Safety::Collision = 0;

  resetRiskState();
  failsafeActive = 1;
  failsafeReason = FS_PEDAL_COMM;

  hapCnt = 0;
  motCnt = 0;

  setTimer(tEval, RISK_EVAL_PERIOD_MS);
  setTimer(tTx, CMD_TX_PERIOD_MS);
}

// ============================================================================
// Reception
// ============================================================================

// PEDAL_STATUS: DLC / range check (decoder), Alive Counter check (main.py)
on message PEDAL_STATUS
{
  long cur;
  long delta;
  long expected;
  int  aliveValid;

  if (this.dir != RX) return;
  if (this.dlc != 8) return;                                // decoder: must be 8 bytes
  if ((this.byte(0) > 100) || (this.byte(1) > 100)) return; // decoder: out of range

  cur = this.byte(7);
  aliveValid = 0;

  if (pedalConnected == 0)
  {
    // Recovery after timeout: two consecutive Alive values are required
    if (recoveryAliveCand < 0)
    {
      recoveryAliveCand = cur;
    }
    else
    {
      expected = (recoveryAliveCand + 1) & 0xFF;
      if (cur == expected)
      {
        aliveValid = 1;
        prevAlive = cur;
        recoveryAliveCand = -1;
      }
      else
      {
        recoveryAliveCand = cur;
      }
    }
  }
  else
  {
    aliveValid = 1;
    if (prevAlive >= 0)
    {
      delta = (cur - prevAlive) & 0xFF;
      if (delta == 0)
      {
        aliveValid = 0;                                       // duplicate
        @Safety::PedalAliveDupCnt = @Safety::PedalAliveDupCnt + 1;
      }
      else if (delta >= 128)
      {
        aliveValid = 0;                                       // backward
        @Safety::PedalAliveBackCnt = @Safety::PedalAliveBackCnt + 1;
      }
      else if (delta >= 2)
      {
        @Safety::PedalAliveSkipCnt = @Safety::PedalAliveSkipCnt + 1;   // skip: accepted
      }
    }
    if (aliveValid) prevAlive = cur;
  }

  if (aliveValid)
  {
    accel        = this.byte(0);
    brake        = this.byte(1);
    accelRate    = this.Pdl_AccelRate.phys;   // int16 LE * 0.1 %/s
    brakeRate    = this.Pdl_BrakeRate.phys;
    sensorStatus = this.byte(6);
    pedalConnected = 1;
    lastPedalTime  = nowMs();
    pedalTimeoutReported = 0;
  }
}

// HAPTIC_STATUS: decoder validation, then state.update_haptic()
on message HAPTIC_STATUS
{
  long vib;
  long inten;
  long freq;

  if (this.dir != RX) return;
  if (this.dlc != 8) return;
  if (this.byte(0) > 3) return;
  vib   = this.byte(1);
  inten = this.byte(2);
  freq  = this.byte(3);
  if (vib > 1) return;
  if (vib == 0)
  {
    if ((inten != 0) || (freq != 0)) return;
  }
  else
  {
    if ((inten < 1) || (inten > 100)) return;
    if ((freq < 10) || (freq > 50)) return;
  }
  if (this.byte(5) > 1) return;
  if (this.byte(6) > 1) return;

  hapFault        = this.byte(4);
  hapCmdTimeout   = this.byte(5);
  hapEcuStatus    = this.byte(6);
  hapticConnected = 1;
  lastHapticTime  = nowMs();
}

// MOTOR_STATUS: decoder validation
on message MOTOR_STATUS
{
  if (this.dir != RX) return;
  if (this.dlc != 8) return;
  if (this.byte(0) > 100) return;
  if (this.byte(1) > 100) return;
  if (this.byte(4) > 3) return;
  if ((this.byte(5) & 0xF0) != 0) return;

  motPwm        = this.byte(0);
  motState      = this.byte(4);
  motFaultFlags = this.byte(5);
  motStatusReceived = 1;
  motLastRxTime = nowMs();
}

// ============================================================================
// Main loop: risk evaluation
// ============================================================================
on timer tEval
{
  float tNow;
  float dt;

  setTimer(tEval, RISK_EVAL_PERIOD_MS);
  tNow = nowMs();
  dt = RISK_EVAL_PERIOD_MS / 1000.0;

  // Pedal timeout
  if ((tNow - lastPedalTime) >= PEDAL_TIMEOUT_MS)
  {
    pedalConnected = 0;
    if (pedalTimeoutReported == 0)
    {
      recoveryAliveCand = -1;
      pedalTimeoutReported = 1;
    }
  }

  // Haptic freshness (monitored only, no command change in the real Safety ECU)
  if (hapticConnected && ((tNow - lastHapticTime) >= HAPTIC_TIMEOUT_MS))
  {
    hapticConnected = 0;
  }

  evaluateRisk(dt);
  evaluateFailsafe();
  publishState();
}

void evaluateRisk(float dt)
{
  int   carlaConnected;
  int   obstaclePresent;
  float speedKmh;
  float closingMps;
  float distM;
  float ttc;
  int   ttcValid;
  float vMps;

  // ---- Simulated CARLA input ----
  carlaConnected = (@Safety::EnvLink == 1);
  obstaclePresent = (@Safety::ObstaclePresent == 1);
  ttc = 0;
  ttcValid = 0;

  if (@Safety::EnvOvrEn == 1)
  {
    // Test injection: inputs given directly (same fields as one CARLA packet)
    distM      = @Safety::EnvOvrDist;
    speedKmh   = @Safety::EnvOvrSpeedKmh;
    closingMps = @Safety::EnvOvrClosing;
    ttc        = @Safety::EnvOvrTtc;
    ttcValid   = (ttc >= 0) && obstaclePresent;
    if (!obstaclePresent) closingMps = 0.0;
    obsDist = distM;
  }
  else
  {
    // Vehicle physics from the Motor node model (CARLA reports speed directly)
    vMps = @Motor::ModelSpeed;
    if (vMps < 0) vMps = 0;
    speedKmh = vMps * 3.6;

    // Static obstacle approached by the own vehicle
    obsDist = obsDist - vMps * dt;
    if (obsDist <= 0)
    {
      obsDist = 0;
      if (vMps > 0.05) @Safety::Collision = 1;
    }
    distM = obsDist;

    if (obstaclePresent)
    {
      closingMps = vMps;
      if (closingMps > 0)
      {
        ttcValid = 1;
        ttc = distM / closingMps;
      }
    }
    else
    {
      closingMps = 0.0;
    }
  }
  envTtcValid = ttcValid;
  envTtc = ttc;

  @Safety::ToFDistance  = distM;
  @Safety::VehicleSpeed = speedKmh;

  // ---- BNS (risk/bns.py) ----
  calcBns(carlaConnected, obstaclePresent, distM, speedKmh, closingMps, ttc, ttcValid);

  // ---- PMS (risk/pms.py) ----
  calcPms();

  // ---- RiskManager (risk/risk_manager.py) ----
  if (@Safety::AutoRisk == 0)
  {
    // TEST: manual risk level (not part of the real Safety ECU)
    riskLevel = clampL(@Safety::RiskLevel, 0, 3);
    riskAvailable = 1;
    totalRisk = maxF(clampF(bnsScore, 0, 1), clampF(pmsScore, 0, 1));
    return;
  }
  riskEvaluate();
}

void calcBns(int connected, int obstaclePresent, float distM, float speedKmh,
             float closingMps, float ttc, int ttcValid)
{
  float dm;
  int   usableTtc;
  float sDist;
  float sTtc;

  bnsScore = 0.0;
  bnsAvailable = 0;
  dL1 = 0; dL2 = 0; dL3 = 0;
  tL1 = 0; tL2 = 0; tL3 = 0;

  if (!connected) return;
  if (speedKmh < 0) return;
  if (obstaclePresent && (distM < 0)) return;
  if (ttcValid && ((ttc < 0) || !obstaclePresent)) return;

  bnsAvailable = 1;
  // main.py passes distance in cm, bns.py converts back to m
  dm = (distM * 100.0) / 100.0;
  usableTtc = ttcValid && (closingMps > 0);

  if (obstaclePresent)
  {
    dL1 = (dm <= BNS_DISTANCE_L1_M);
    dL2 = (dm <= BNS_DISTANCE_L2_M);
    dL3 = (dm <= BNS_DISTANCE_L3_M);
  }
  if (usableTtc)
  {
    tL1 = (ttc <= BNS_TTC_L1_S);
    tL2 = (ttc <= BNS_TTC_L2_S);
    tL3 = (ttc <= BNS_TTC_L3_S);
  }

  sDist = 0.0;
  sTtc  = 0.0;
  if (obstaclePresent) sDist = severityDesc(dm, BNS_DISTANCE_L1_M, BNS_DISTANCE_L2_M, BNS_DISTANCE_L3_M);
  if (usableTtc)       sTtc  = severityDesc(ttc, BNS_TTC_L1_S, BNS_TTC_L2_S, BNS_TTC_L3_S);
  bnsScore = maxF(sDist, sTtc);
}

void calcPms()
{
  float sAcc;
  float sRate;

  pmsScore = 0.0;
  pmsAvailable = 0;
  pedalConflict = 0;
  pL1 = 0; pL2 = 0; pL3 = 0;

  if (!pedalConnected) return;
  if (sensorStatus != 0) return;           // also covers "None" (-1)
  if ((accel < 0) || (accel > 100) || (brake < 0) || (brake > 100)) return;

  pmsAvailable = 1;
  pedalConflict = (accel >= PMS_CONFLICT_ACCEL_PERCENT) && (brake >= PMS_CONFLICT_BRAKE_PERCENT);

  if (brake < PMS_BRAKE_SUPPRESSION_PERCENT)
  {
    pL1 = (accel >= PMS_ACCEL_L1_PERCENT) || (accelRate >= PMS_ACCEL_RATE_L1);
    pL2 = (accel >= PMS_ACCEL_L2_PERCENT) || (accelRate >= PMS_ACCEL_RATE_L2);
    pL3 = (accel >= PMS_ACCEL_L3_PERCENT) || (accelRate >= PMS_ACCEL_RATE_L3);
    sAcc  = severityAsc(accel, PMS_ACCEL_L1_PERCENT, PMS_ACCEL_L2_PERCENT, PMS_ACCEL_L3_PERCENT);
    sRate = severityAsc(accelRate, PMS_ACCEL_RATE_L1, PMS_ACCEL_RATE_L2, PMS_ACCEL_RATE_L3);
    pmsScore = maxF(sAcc, sRate);
  }
  if (pedalConflict)
  {
    pL1 = 1;
    pL2 = 1;
    pmsScore = maxF(pmsScore, PMS_CONFLICT_SCORE);
  }
}

// bns.py _severity: descending anchors L1=.35, L2=.65, L3=.90, zero=1
float severityDesc(float value, float l1, float l2, float l3)
{
  if (value > l1) return 0.0;
  if (value >= l2) return 0.35 + (0.65 - 0.35) * (l1 - value) / (l1 - l2);
  if (value >= l3) return 0.65 + (0.90 - 0.65) * (l2 - value) / (l2 - l3);
  if (value >= 0.0) return 0.90 + (1.0 - 0.90) * (l3 - value) / (l3 - 0.0);
  return 1.0;
}

// pms.py _severity: increasing anchors .35/.65/.90, saturate one tier above L3
float severityAsc(float value, float l1, float l2, float l3)
{
  float top;
  top = l3 + l3 - l2;
  if (value < l1) return 0.0;
  if (value <= l2) return 0.35 + (0.65 - 0.35) * (value - l1) / (l2 - l1);
  if (value <= l3) return 0.65 + (0.90 - 0.65) * (value - l2) / (l3 - l2);
  if (value <= top) return 0.90 + (1.0 - 0.90) * (value - l3) / (top - l3);
  return 1.0;
}

// risk_manager.py evaluate()
void riskEvaluate()
{
  long cand;

  if (!(bnsAvailable && pmsAvailable))
  {
    totalRisk = 0.0;
    riskLevel = 0;
    riskAvailable = 0;
    candidateLevel = 0;
    prevCandidateLevel = 0;
    candidateCount = 0;
    return;
  }

  totalRisk = maxF(clampF(bnsScore, 0, 1), clampF(pmsScore, 0, 1));

  // 2-of-3 rule, highest level first
  cand = 0;
  if ((dL1 + tL1 + pL1) >= 2) cand = 1;
  if ((dL2 + tL2 + pL2) >= 2) cand = 2;
  if ((dL3 + tL3 + pL3) >= 2) cand = 3;

  updateCandidateConfirmation(cand);
  riskAvailable = 1;
}

// risk_manager.py update_candidate_confirmation()
void updateCandidateConfirmation(long cand)
{
  candidateLevel = cand;

  if (candidateLevel == prevCandidateLevel)
  {
    candidateCount = candidateCount + 1;
  }
  else
  {
    prevCandidateLevel = candidateLevel;
    candidateCount = 1;
  }

  if (candidateLevel == riskLevel)
  {
    candidateCount = 0;
    prevCandidateLevel = candidateLevel;
    return;
  }

  if (candidateLevel > riskLevel)
  {
    if (candidateCount >= UP_CONFIRM_COUNT_REQUIRED)
    {
      riskLevel = candidateLevel;
      candidateCount = 0;
      prevCandidateLevel = riskLevel;
    }
    return;
  }

  // candidateLevel < riskLevel
  if (candidateCount >= DOWN_CONFIRM_COUNT_REQUIRED)
  {
    riskLevel = riskLevel - 1;          // one level at a time
    candidateCount = 0;
    prevCandidateLevel = candidateLevel;
  }
}

// control/failsafe.py (CARLA mode)
void evaluateFailsafe()
{
  if (@Safety::EnvLink != 1)
  {
    failsafeActive = 1;
    failsafeReason = FS_CARLA_LINK;
    return;
  }
  if (!pedalConnected)
  {
    failsafeActive = 1;
    failsafeReason = FS_PEDAL_COMM;
    return;
  }
  if ((sensorStatus >= 0) && (sensorStatus != 0))
  {
    failsafeActive = 1;
    failsafeReason = FS_PEDAL_SENSOR;
    return;
  }
  failsafeActive = 0;
  failsafeReason = FS_NONE;
}

void resetRiskState()
{
  bnsScore = 0; bnsAvailable = 0;
  pmsScore = 0; pmsAvailable = 0;
  dL1 = 0; dL2 = 0; dL3 = 0;
  tL1 = 0; tL2 = 0; tL3 = 0;
  pL1 = 0; pL2 = 0; pL3 = 0;
  pedalConflict = 0;
  totalRisk = 0;
  riskLevel = 0;
  riskAvailable = 0;
  candidateLevel = 0;
  prevCandidateLevel = 0;
  candidateCount = 0;
  envTtc = 0;
  envTtcValid = 0;
}

void publishState()
{
  if (envTtcValid) @Safety::TTC = minF(envTtc, 99.9);
  else             @Safety::TTC = 99.9;               // TTC None
  @Safety::BNS       = bnsScore;
  @Safety::PMS       = pmsScore;
  @Safety::TotalRisk = totalRisk;
  @Safety::RiskOut   = riskLevel;
  @Safety::RiskAvailable = riskAvailable;
  @Safety::Candidate = candidateLevel;
  @Safety::CondL1 = dL1 + tL1 + pL1;
  @Safety::CondL2 = dL2 + tL2 + pL2;
  @Safety::CondL3 = dL3 + tL3 + pL3;
  @Safety::CondDist  = dL1 + dL2 * 2 + dL3 * 4;
  @Safety::CondTtc   = tL1 + tL2 * 2 + tL3 * 4;
  @Safety::CondPedal = pL1 + pL2 * 2 + pL3 * 4;
  @Safety::PedalConflict  = pedalConflict;
  @Safety::FailSafe       = failsafeActive;
  @Safety::FailSafeReason = failsafeReason;
  @Safety::PedalTimeout   = !pedalConnected;
  @Safety::HapStsTimeout  = !hapticConnected;
}

// ============================================================================
// Command transmission (10 ms)
// ============================================================================
on timer tTx
{
  float tNow;
  byte  vib;
  byte  inten;
  byte  freq;
  byte  mode;
  byte  limit;
  byte  flags;
  int   motFresh;
  int   estopActive;
  int   otherFault;
  int   safeToRecover;
  float dtMot;

  setTimer(tTx, CMD_TX_PERIOD_MS);
  tNow = nowMs();

  // ---- command_mapper.map() ----
  if (failsafeActive)
  {
    vib = 0; inten = 0; freq = 0;
    mode = MODE_STOP; limit = 0; flags = FLAG_VALID | FLAG_ESTOP;
  }
  else if (!riskAvailable)
  {
    vib = 0; inten = 0; freq = 0;
    mode = MODE_NORMAL; limit = 100; flags = FLAG_VALID;
  }
  else
  {
    vib   = mapVibCmd[riskLevel];
    inten = mapIntensity[riskLevel];
    freq  = mapFrequency[riskLevel];
    mode  = mapCtrlMode[riskLevel];
    limit = mapOutLimit[riskLevel];
    flags = FLAG_VALID;
  }

  // ---- Motor ECU communication / E-STOP recovery (main.py) ----
  dtMot = tNow - motLastRxTime;
  motFresh = motStatusReceived && (dtMot >= 0) && (dtMot <= MOTOR_STATUS_FRESH_MS);

  if (!motFresh)
  {
    motRecoveryRequired = 1;
    mode = MODE_STOP; limit = 0; flags = FLAG_VALID | FLAG_ESTOP;
  }
  else
  {
    estopActive = ((motFaultFlags & 0x08) != 0);
    otherFault  = ((motFaultFlags & 0x07) != 0);
    safeToRecover = (!failsafeActive) && pedalConnected && (sensorStatus == 0)
                    && (accel <= RECOVERY_ACCEL_MAX_PERCENT)
                    && (brake < RECOVERY_BRAKE_MAX_PERCENT)
                    && (!otherFault);

    if (failsafeActive)
    {
      motRecoveryRequired = 1;
    }
    else if (estopActive)
    {
      motRecoveryRequired = 1;
      if (safeToRecover)
      {
        mode = MODE_STOP; limit = 0; flags = FLAG_VALID;   // clear E-STOP, keep STOP
      }
    }
    else if (motRecoveryRequired)
    {
      if (safeToRecover && (motState == 0) && (motPwm == 0))
      {
        motRecoveryRequired = 0;
        write("Safety: Motor E-STOP recovery confirmed");
      }
      mode = MODE_STOP; limit = 0; flags = FLAG_VALID;     // keep STOP this cycle
    }
  }

  @Safety::MotStsTimeout  = !motFresh;
  @Safety::MotorRecovery  = motRecoveryRequired;
  @Safety::CtrlModeOut    = mode;
  @Safety::OutLimitOut    = limit;
  @Safety::CmdFlagsOut    = flags;

  sendHapticCommand(riskLevel, vib, inten, freq);
  sendMotorCommand(riskLevel, mode, limit, flags);

  // Alive counters advance every cycle (TEST hooks can freeze them)
  if (@Safety::HapCmdAliveFault == 0) hapCnt = nextCnt(hapCnt);
  if (@Safety::MotCmdAliveFault == 0) motCnt = nextCnt(motCnt);
}

// 0x110: Byte0 risk, Byte1 vib, Byte2 intensity, Byte3 frequency, Byte4..6 0, Byte7 alive
void sendHapticCommand(long risk, byte vib, byte inten, byte freq)
{
  if (@Safety::TxStop_HapCmd == 1) return;

  mHapCmd.dlc = 8;
  mHapCmd.byte(0) = risk;
  mHapCmd.byte(1) = vib;
  mHapCmd.byte(2) = inten;
  mHapCmd.byte(3) = freq;
  if (@Safety::HapCmdInvalid == 1)
  {
    // TEST: ON command with intensity 0 (rejected by the Haptic ECU)
    mHapCmd.byte(1) = 1;
    mHapCmd.byte(2) = 0;
    mHapCmd.byte(3) = 20;
  }
  mHapCmd.byte(4) = 0;
  mHapCmd.byte(5) = 0;
  mHapCmd.byte(6) = 0;
  mHapCmd.byte(7) = hapCnt;
  output(mHapCmd);
}

// 0x120: Byte0 mode, Byte1 limit, Byte2 risk, Byte3 flags, Byte4..6 0, Byte7 alive
void sendMotorCommand(long risk, byte mode, byte limit, byte flags)
{
  if (@Safety::TxStop_MotCmd == 1) return;

  mMotCmd.dlc = 8;
  mMotCmd.byte(0) = mode;
  mMotCmd.byte(1) = limit;
  mMotCmd.byte(2) = risk;
  mMotCmd.byte(3) = flags;
  if (@Safety::Dbg_CmdInvalid == 1) mMotCmd.byte(3) = flags & 0xFE;   // TEST: Command Valid = 0
  mMotCmd.byte(4) = 0;
  mMotCmd.byte(5) = 0;
  mMotCmd.byte(6) = 0;
  mMotCmd.byte(7) = motCnt;
  output(mMotCmd);
}

// ============================================================================
// Simulation reset (Panel RESET button): obstacle placed again, risk state cleared
// Pedal.can clears the pedal inputs and all fault injections on the same event
// ============================================================================
on sysvar_update Safety::ObstacleReset
{
  if (@Safety::ObstacleReset != 1) return;

  obsDist = @Safety::ObstacleInitDist;
  @Safety::ToFDistance = obsDist;
  @Safety::Collision = 0;
  @Safety::AutoRisk  = 1;
  @Safety::RiskLevel = 0;
  @Safety::PedalAliveDupCnt  = 0;
  @Safety::PedalAliveBackCnt = 0;
  @Safety::PedalAliveSkipCnt = 0;
  resetRiskState();
  write("Safety: simulation reset, obstacle at %.1f m", obsDist);
}

// ---- Common helpers ----
// Current measurement time in milliseconds (timeNow() is in 10 us units)
float nowMs()
{
  return timeNow() / 100.0;
}

long clampL(long x, long lo, long hi)
{
  if (x < lo) return lo;
  if (x > hi) return hi;
  return x;
}

float clampF(float x, float lo, float hi)
{
  if (x < lo) return lo;
  if (x > hi) return hi;
  return x;
}

float maxF(float a, float b)
{
  if (a > b) return a;
  return b;
}

float minF(float a, float b)
{
  if (a < b) return a;
  return b;
}

// Alive counter: 0 -> 255 -> 0
byte nextCnt(byte cnt)
{
  if (cnt >= 255) return 0;
  return cnt + 1;
}
